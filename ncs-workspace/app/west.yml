## ncs-workspace/app/west.yml
```yaml
manifest:
  remotes:
    - name: ncs
      url-base: https://github.com/nrfconnect
  projects:
    - name: sdk-nrf
      remote: ncs
      path: nrf
      revision: v3.2.1
      clone-depth: 1
      import:
        name-allowlist:
          - zephyr
          - cmsis_6
          - hal_nordic
          - mbedtls
          - mcuboot
          - nrfxlib
          - oberon-psa-crypto
          - zcbor
  self:
    path: app
```
